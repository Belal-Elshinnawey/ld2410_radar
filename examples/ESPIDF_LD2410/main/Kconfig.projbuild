## examples/ESPIDF_LD2410/main/Kconfig.projbuild
```kconfig
menu "Radar Control Configuration"
    config RADAR_UART_NUM
        int "Door Control GPIO"
        range 0 2
        default 1
        help
            UART  Number to use for radar.
    config RADAR_UART_TX
        int "Radar TX PIN"
        default 17
        help
            UART TX Connected to Radar.
    config RADAR_UART_RX
        int "Radar RX PIN"
        default 16
        help
            UART RX Connected to Radar.
endmenu
```

## examples/NRF_CSDK_LD2410/boards/arm/radar53/Kconfig.board
```kconfig
if SOC_NRF5340_CPUAPP_QKAA

config BOARD_RADAR53_CPUAPP
	bool "nRF5340 DK nRF5340 Application MCU"

config BOARD_RADAR53_CPUAPP_NS
	bool "nRF5340 DK nRF5340 Application MCU non-secure"

endif # SOC_NRF5340_CPUAPP_QKAA

config BOARD_RADAR53_CPUNET
	bool "nRF5340 DK NRF5340 Network MCU"
	depends on SOC_NRF5340_CPUNET_QKAA
```

## examples/NRF_CSDK_LD2410/boards/arm/radar53/Kconfig.defconfig
```kconfig
if  BOARD_RADAR53_CPUAPP || BOARD_RADAR53_CPUAPP_NS

config BOARD
	default "radar53_cpuapp" if BOARD_RADAR53_CPUAPP || BOARD_RADAR53_CPUAPP_NS

config BUILD_WITH_TFM
	default y if BOARD_RADAR53_CPUAPP_NS

if BUILD_WITH_TFM

config TFM_FLASH_MERGED_BINARY
	bool
	default y

endif # BUILD_WITH_TFM

DT_CHOSEN_Z_CODE_PARTITION := zephyr,code-partition
DT_CHOSEN_Z_SRAM_PARTITION := zephyr,sram-secure-partition

if BOARD_RADAR53_CPUAPP && TRUSTED_EXECUTION_SECURE

config FLASH_LOAD_SIZE
	default $(dt_chosen_reg_size_hex,$(DT_CHOSEN_Z_CODE_PARTITION))

config SRAM_SIZE
	default $(dt_chosen_reg_size_int,$(DT_CHOSEN_Z_SRAM_PARTITION),0,K)

endif # BOARD_RADAR53_CPUAPP && TRUSTED_EXECUTION_SECURE

if BOARD_RADAR53_CPUAPP_NS

config FLASH_LOAD_OFFSET
	default $(dt_chosen_reg_addr_hex,$(DT_CHOSEN_Z_CODE_PARTITION))

config FLASH_LOAD_SIZE
	default $(dt_chosen_reg_size_hex,$(DT_CHOSEN_Z_CODE_PARTITION))

endif # BOARD_RADAR53_CPUAPP_NS

endif # BOARD_RADAR53_CPUAPP || BOARD_RADAR53_CPUAPP_NS

config BOARD
	default "radar53_cpunet" if BOARD_RADAR53_CPUNET

config MBOX_NRFX_IPC
	default MBOX

if BOARD_RADAR53_CPUAPP || BOARD_RADAR53_CPUAPP_NS

choice BT_HCI_BUS_TYPE
	default BT_RPMSG if BT
endchoice

config HEAP_MEM_POOL_SIZE
	default 4096 if BT_RPMSG

endif #  BOARD_RADAR53_CPUAPP || BOARD_RADAR53_CPUAPP_NS

if BOARD_RADAR53_CPUNET

config BT_CTLR
	default y if BT

endif # BOARD_RADAR53_CPUNET

config UART_NRF_DK_SERIAL_WORKAROUND
	default y if ZTEST

# When the nRF DK serial workaround is enabled, increase the stack size in
# tests built with no optimizations, as the standard size may be insufficient
# then. Use 512 to align with the FPU_SHARING case, where the default value
# is also modified.
config TEST_EXTRA_STACK_SIZE
	default 512 if UART_NRF_DK_SERIAL_WORKAROUND && NO_OPTIMIZATIONS
```
