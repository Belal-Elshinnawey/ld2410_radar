/dts-v1/;
#include <nordic/nrf5340_cpuappns_qkaa.dtsi>
#include "nrf5340_cpuapp_common.dts"

/ {
	model = "Nordic NRF5340 DK NRF5340 Application";
	compatible = "radar,radar53_cpuapp";


	chosen {
		zephyr,sram = &sram0_s;
		zephyr,flash = &flash0;
		zephyr,code-partition = &slot0_partition;
	};
	// chosen {
		//     zephyr,sram = &sram0_ns;
		//     zephyr,flash = &flash0;
		//     zephyr,code-partition = &slot0_ns_partition;
	// };
};